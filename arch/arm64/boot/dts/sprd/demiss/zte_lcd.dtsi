
#include "zte_lcd_lianchuang_icnl9911s_boe_6p82_hd_3lane.dtsi"
#include "zte_lcd_lianchuang_icnl9911c_boe_6p82_hd_3lane.dtsi"
#include "zte_lcd_lead_hx83102d_boe_6p82_hd_3lane.dtsi"
#include "zte_lcd_dummy_mipi.dtsi"

&dphy {
	/delete-property/ sprd,ulps-disabled;
};
&i2c4 {
	ti65132b@3e {
		compatible = "tps,ti65132b";
		reg = <0x3e>;
		/*if set tps65132b_enhance_value,means bigger than this board_id*/
		zte,tps65132b_enhance_value = <0xffff>;
	};
};

&panel {
	/*sprd,surface-width = <720>;*/
	/*sprd,surface-height = <1640>;*/
	iovdd-gpio = <&ap_gpio 62 GPIO_ACTIVE_HIGH>;
	avdd-gpio = <&ap_gpio 4 GPIO_ACTIVE_HIGH>;
	avee-gpio = <&ap_gpio 5 GPIO_ACTIVE_HIGH>;
	reset-gpio = <&ap_gpio 50 GPIO_ACTIVE_HIGH>;
};
