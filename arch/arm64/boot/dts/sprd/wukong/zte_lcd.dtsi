
#include "zte_lcd_lcetron_hx83113a_boe_6p67_fhd.dtsi"
#include "zte_lcd_tianma_hx83113a_tianma_6p67_fhd.dtsi"
#include "zte_lcd_dummy_mipi.dtsi"

&dphy {
	/delete-property/ sprd,ulps-disabled;
};

&i2c4 {
	ti65132b@3e {
		compatible = "tps,ti65132b";
		reg = <0x3e>;
		/*if set tps65132b_enhance_value,means bigger than this board_id*/
		zte,tps65132b_enhance_value = <0xffff>;
	};
};

&panel {
	avdd-gpio = <&ap_gpio 63 GPIO_ACTIVE_HIGH>;
	avee-gpio = <&ap_gpio 39 GPIO_ACTIVE_HIGH>;
	reset-gpio = <&ap_gpio 50 GPIO_ACTIVE_HIGH>;
};
