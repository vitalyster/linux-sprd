&i2c4 {
	//status = "okay";
	//clock-frequency = <400000>;
		nfc_pn5xx: pn544@29 {
		compatible = "nxp,pn544";
		reg = <0x29>;
		interrupt-parent = <&ap_gpio>;
		interrupts = <53 0>;
		nxp,pn544-irq = <&ap_gpio 53 0>;
		nxp,pn544-ven = <&ap_gpio 137 0>;
		nxp,pn544-fw-dwnld = <&ap_gpio 88 0>;
		interrupt-names = "nfc_int";
	};
};

