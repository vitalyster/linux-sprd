/*****************************************
Do not modify dts file, please modify according dtsi file
******************************************/
#include "../ums512.dts"
#include "sprd_base_diff.dtsi"

