/*****************************************
Do not modify dts file, please modify according dtsi file
******************************************/
#include "../sp9832e.dts"
#include "sprd_base_diff.dtsi"

